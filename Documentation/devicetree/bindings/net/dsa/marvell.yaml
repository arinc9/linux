## Documentation/devicetree/bindings/net/dsa/marvell.yaml
```yaml
# SPDX-License-Identifier: (GPL-2.0-only OR BSD-2-Clause)
%YAML 1.2
---
$id: http://devicetree.org/schemas/net/dsa/marvell.yaml#
$schema: http://devicetree.org/meta-schemas/core.yaml#

title: Marvell Ethernet Switches

$ref: dsa.yaml#/$defs/ethernet-ports

maintainers:
  - Andrew Lunn <andrew@lunn.ch>
  - Arınç ÜNAL <arinc.unal@arinc9.com>

description:
  Marvell ethernet switches are MDIO devices.

properties:
  compatible:
    description:
      The compatibility string is used only to find an identification register,
      which is at a different MDIO base address in different switch families.
    oneOf:
      - description: |
          Switch has base address 0x10. Use with models:
          6085, 6095, 6097, 6123, 6131, 6141, 6161, 6165, 6171, 6172, 6175,
          6176, 6185, 6240, 6320, 6321, 6341, 6350, 6351, 6352
        const: marvell,mv88e6085

      - description: |
          Switch has base address 0x00. Use with models:
          6190, 6190X, 6191, 6191X, 6290, 6361, 6390, 6390X, 6393X
        const: marvell,mv88e6190

      - description: |
          Switch has base address 0x08 or 0x18. Use with models:
          6220, 6250
        const: marvell,mv88e6250

  reg:
    maxItems: 1

  reset-gpios:
    description: GPIO to be used to reset the whole device
    maxItems: 1

  "#interrupt-cells":
    const: 2

  interrupt-controller: true

  interrupts:
    maxItems: 1

  eeprom-length:
    description:
      Set to the length of an EEPROM connected to the switch. Must be set if the
      switch can not detect the presence and/or size of a connected EEPROM,
      otherwise optional.

  mdio:
    description:
      The optional node for the MDIO bus of the switch. The bus will be
      registered non-OF-based if this is not defined.
    $ref: /schemas/net/mdio.yaml#
    unevaluatedProperties: false

required:
  - compatible
  - reg

allOf:
  - if:
      properties:
        compatible:
          const: marvell,mv88e6190
    then:
      properties:
        mdio-external:
          description:
            The externally reachable MDIO bus of the 6390 family switches.
          $ref: /schemas/net/mdio.yaml#
          unevaluatedProperties: false

          properties:
            compatible:
              const: marvell,mv88e6xxx-mdio-external

          required:
            - compatible

  - if:
      required: [ mdio ]
    then:
      patternProperties:
        "^(ethernet-)?ports$":
          patternProperties:
            "^(ethernet-)?port@[0-9]+$":
              $ref: /schemas/net/ethernet-controller.yaml#/$defs/phylink

unevaluatedProperties: false

examples:
  - |
    #include <dt-bindings/gpio/gpio.h>

    mdio {
        #address-cells = <1>;
        #size-cells = <0>;

        switch@0 {
            compatible = "marvell,mv88e6085";
            reg = <0>;
            reset-gpios = <&gpio5 1 GPIO_ACTIVE_LOW>;

            ethernet-ports {
                #address-cells = <1>;
                #size-cells = <0>;

                port@0 {
                    reg = <0>;
                    phy-mode = "rmii";
                    ethernet = <&fec1>;

                    fixed-link {
                        speed = <100>;
                        full-duplex;
                    };
                };

                port@1 {
                    reg = <1>;
                    label = "swp1";
                };
            };
        };
    };

  - |
    #include <dt-bindings/gpio/gpio.h>
    #include <dt-bindings/interrupt-controller/irq.h>

    mdio {
        #address-cells = <1>;
        #size-cells = <0>;

        switch: switch@0 {
            compatible = "marvell,mv88e6190";
            reg = <0>;
            reset-gpios = <&gpio5 1 GPIO_ACTIVE_LOW>;
            interrupt-parent = <&gpio3>;
            interrupts = <2 IRQ_TYPE_LEVEL_LOW>;
            interrupt-controller;
            #interrupt-cells = <2>;

            ethernet-ports {
                #address-cells = <1>;
                #size-cells = <0>;

                port@0 {
                    reg = <0>;
                    phy-mode = "rmii";
                    ethernet = <&fec1>;

                    fixed-link {
                        speed = <100>;
                        full-duplex;
                    };
                };

                port@1 {
                    reg = <1>;
                    label = "swp1";
                    phy-handle = <&ethphy1>;
                };

                port@2 {
                    reg = <2>;
                    label = "swp2";
                    phy-handle = <&ext_ethphy0>;
                };
            };

            mdio {
                #address-cells = <1>;
                #size-cells = <0>;

                ethphy1: ethernet-phy@1 {
                    reg = <1>;
                    interrupt-parent = <&switch>;
                    interrupts = <1 IRQ_TYPE_LEVEL_HIGH>;
                };
            };

            mdio-external {
                compatible = "marvell,mv88e6xxx-mdio-external";
                #address-cells = <1>;
                #size-cells = <0>;

                ext_ethphy0: ethernet-phy@0 {
                    reg = <0>;
                    compatible = "ethernet-phy-ieee802.3-c45";
                };
            };
        };
    };
```

## Documentation/devicetree/bindings/net/marvell-armada-370-neta.yaml
```yaml
# SPDX-License-Identifier: (GPL-2.0-only OR BSD-2-Clause)
%YAML 1.2
---
$id: http://devicetree.org/schemas/net/marvell-armada-370-neta.yaml#
$schema: http://devicetree.org/meta-schemas/core.yaml#

title: Marvell Armada 370 / Armada XP / Armada 3700 Ethernet Controller (NETA)

allOf:
  - $ref: ethernet-controller.yaml#
  - $ref: ethernet-controller.yaml#/$defs/phylink

maintainers:
  - Arınç ÜNAL <arinc.unal@arinc9.com>

properties:
  compatible:
    enum:
      - marvell,armada-370-neta
      - marvell,armada-xp-neta
      - marvell,armada-3700-neta
      - marvell,armada-ac5-neta

  reg:
    maxItems: 1

  interrupts:
    maxItems: 1

  clocks:
    description:
      List of clocks for this device. At least one clock is mandatory for the
      core clock. If several clocks are given, then the clock-names property
      must be used to identify them.

  tx-csum-limit:
    description:
      Maximum mtu supported by port that allow TX checksum. Value is presented
      in bytes. If not used, by default 1600B is set for
      "marvell,armada-370-neta" and 9800B for others.

  clock-names:
    description:
      List of names corresponding to clocks property; shall be "core" for core
      clock and "bus" for the optional bus clock.

  phys:
    description:
      comphy for the ethernet port, see ../phy/phy-bindings.txt.

if:
  properties:
    compatible:
      enum:
        - marvell,armada-370-neta
        - marvell,armada-xp-neta
then:
  properties:
    buffer-manager:
      description:
        A phandle to a buffer manager node. Please refer to
        Documentation/devicetree/bindings/net/marvell-neta-bm.txt.

    bm,pool-long:
      description:
        ID of a pool, that will accept all packets of a size higher than 'short'
        pool's threshold (if set) and up to MTU value. Obligatory, when the port
        is supposed to use hardware buffer management.

    bm,pool-short:
      description:
        ID of a pool, that will be used for accepting packets of a size lower
        than given threshold. If not set, the port will use a single 'long' pool
        for all packets, as defined above.

required:
  - compatible
  - reg
  - interrupts
  - phy-mode
  - clocks

unevaluatedProperties: false

examples:
  - |
    ethernet@70000 {
        compatible = "marvell,armada-370-neta";
        reg = <0x70000 0x2500>;
        interrupts = <8>;
        clocks = <&gate_clk 4>;
        tx-csum-limit = <9800>;
        phy-mode = "rgmii-id";
        buffer-manager = <&bm>;
        bm,pool-long = <0>;
        bm,pool-short = <1>;

        fixed-link {
            speed = <1000>;
            full-duplex;
        };
    };
```

## arch/mips/configs/mt7621_defconfig
```kconfig
CONFIG_KERNEL_LZMA=y
CONFIG_BLK_DEV_INITRD=y
CONFIG_CC_OPTIMIZE_FOR_SIZE=y
CONFIG_RALINK=y
CONFIG_SOC_MT7621=y
CONFIG_NR_CPUS=2
CONFIG_NET=y
CONFIG_PACKET=y
CONFIG_UNIX=y
CONFIG_INET=y
# CONFIG_IPV6 is not set
CONFIG_NETFILTER=y
CONFIG_NF_CONNTRACK=y
CONFIG_NF_TABLES=y
CONFIG_NFT_FLOW_OFFLOAD=y
CONFIG_NFT_MASQ=y
CONFIG_NFT_NAT=y
CONFIG_NF_FLOW_TABLE_INET=y
CONFIG_NF_FLOW_TABLE=y
CONFIG_NF_TABLES_IPV4=y
CONFIG_BRIDGE=y
CONFIG_BRIDGE_VLAN_FILTERING=y
CONFIG_NET_DSA=y
CONFIG_VLAN_8021Q=y
# CONFIG_WIRELESS is not set
CONFIG_DEVTMPFS=y
CONFIG_NETDEVICES=y
CONFIG_NET_DSA_MT7530=y
# CONFIG_NET_VENDOR_ALACRITECH is not set
# CONFIG_NET_VENDOR_AMAZON is not set
# CONFIG_NET_VENDOR_AQUANTIA is not set
# CONFIG_NET_VENDOR_ARC is not set
# CONFIG_NET_VENDOR_ASIX is not set
# CONFIG_NET_VENDOR_BROADCOM is not set
# CONFIG_NET_VENDOR_CADENCE is not set
# CONFIG_NET_VENDOR_CAVIUM is not set
# CONFIG_NET_VENDOR_CORTINA is not set
# CONFIG_NET_VENDOR_DAVICOM is not set
# CONFIG_NET_VENDOR_ENGLEDER is not set
# CONFIG_NET_VENDOR_EZCHIP is not set
# CONFIG_NET_VENDOR_FUNGIBLE is not set
# CONFIG_NET_VENDOR_GOOGLE is not set
# CONFIG_NET_VENDOR_HUAWEI is not set
# CONFIG_NET_VENDOR_INTEL is not set
# CONFIG_NET_VENDOR_LITEX is not set
CONFIG_NET_VENDOR_MEDIATEK=y
CONFIG_NET_MEDIATEK_SOC=y
# CONFIG_NET_VENDOR_MICREL is not set
# CONFIG_NET_VENDOR_MICROCHIP is not set
# CONFIG_NET_VENDOR_MICROSEMI is not set
# CONFIG_NET_VENDOR_MICROSOFT is not set
# CONFIG_NET_VENDOR_NI is not set
# CONFIG_NET_VENDOR_NATSEMI is not set
# CONFIG_NET_VENDOR_NETRONOME is not set
# CONFIG_NET_VENDOR_PENSANDO is not set
# CONFIG_NET_VENDOR_QUALCOMM is not set
# CONFIG_NET_VENDOR_RENESAS is not set
# CONFIG_NET_VENDOR_ROCKER is not set
# CONFIG_NET_VENDOR_SAMSUNG is not set
# CONFIG_NET_VENDOR_SEEQ is not set
# CONFIG_NET_VENDOR_SOLARFLARE is not set
# CONFIG_NET_VENDOR_SMSC is not set
# CONFIG_NET_VENDOR_SOCIONEXT is not set
# CONFIG_NET_VENDOR_STMICRO is not set
# CONFIG_NET_VENDOR_SYNOPSYS is not set
# CONFIG_NET_VENDOR_VERTEXCOM is not set
# CONFIG_NET_VENDOR_VIA is not set
# CONFIG_NET_VENDOR_WANGXUN is not set
# CONFIG_NET_VENDOR_WIZNET is not set
# CONFIG_NET_VENDOR_XILINX is not set
CONFIG_SFP=y
CONFIG_AT803X_PHY=y
# CONFIG_WLAN is not set
CONFIG_SERIAL_8250=y
CONFIG_SERIAL_8250_CONSOLE=y
CONFIG_SERIAL_OF_PLATFORM=y
CONFIG_I2C=y
CONFIG_I2C_MT7621=y
CONFIG_GPIOLIB=y
CONFIG_GPIO_MT7621=y
CONFIG_REGULATOR=y
CONFIG_TMPFS=y
CONFIG_PRINTK_TIME=y
```

## arch/mips/ralink/Kconfig
```kconfig
# SPDX-License-Identifier: GPL-2.0
if RALINK

config CLKEVT_RT3352
	bool
	depends on SOC_RT305X || SOC_MT7620
	default y
	select TIMER_OF
	select CLKSRC_MMIO

config RALINK_ILL_ACC
	bool
	depends on SOC_RT305X
	default y

config IRQ_INTC
	bool
	default y
	depends on !SOC_MT7621

choice
	prompt "SoC selection"
	help
	  Select the SoC.

	config SOC_MT7620
		bool "MediaTek MT7620, MT7628, MT7688"
		select CPU_MIPSR2_IRQ_VI
		select HAVE_PCI
		select SOC_BUS

	config SOC_MT7621
		bool "MediaTek MT7621"
		select MIPS_CPU_SCACHE
		select SYS_SUPPORTS_MULTITHREADING
		select SYS_SUPPORTS_SMP
		select SYS_SUPPORTS_MIPS_CPS
		select SYS_SUPPORTS_HIGHMEM
		select MIPS_GIC
		select CLKSRC_MIPS_GIC
		select HAVE_PCI
		select PCI_DRIVERS_GENERIC
		select SOC_BUS
		select PINCTRL

		help
		  The MT7621 system-on-a-chip includes an 880 MHz MIPS1004Kc
		  dual-core CPU, a 5-port 10/100/1000 switch/PHY and one RGMII.

	config SOC_RT288X
		bool "Ralink RT2880"
		select MIPS_AUTO_PFN_OFFSET
		select MIPS_L1_CACHE_SHIFT_4
		select HAVE_PCI
		select SOC_BUS

	config SOC_RT305X
		bool "Ralink RT3050, RT3052, RT3350, RT3352, RT5350"
		select SOC_BUS

	config SOC_RT3883
		bool "Ralink RT3883"
		select HAVE_PCI
		select SOC_BUS

endchoice

choice
	prompt "Devicetree selection"
	depends on !SOC_MT7621
	default DTB_RT_NONE
	help
	  Select the devicetree.

	config DTB_RT_NONE
		bool "None"

	config DTB_RT2880_EVAL
		bool "RT2880 eval kit"
		depends on SOC_RT288X
		select BUILTIN_DTB

	config DTB_RT305X_EVAL
		bool "RT305x eval kit"
		depends on SOC_RT305X
		select BUILTIN_DTB

	config DTB_RT3883_EVAL
		bool "RT3883 eval kit"
		depends on SOC_RT3883
		select BUILTIN_DTB

	config DTB_MT7620A_EVAL
		bool "MT7620A eval kit"
		depends on SOC_MT7620
		select BUILTIN_DTB

	config DTB_OMEGA2P
		bool "Onion Omega2+"
		depends on SOC_MT7620
		select BUILTIN_DTB

	config DTB_VOCORE2
		bool "VoCore2"
		depends on SOC_MT7620
		select BUILTIN_DTB

endchoice

endif
```

## net/ldt/Kconfig
```kconfig
config LDT
        tristate "ldt"
	depends on IP_MPDCCP
        help
          LDT is a (mp-)dccp tunnel in kernel space.
```

## net/udccp/Kconfig
```kconfig
config UDCCP
        tristate "u-dccp"
        help
          U-DCCP is a netfilter hook to convert DCCP to UDP and vice versa.
```
